## libs/nemea-framework/Config.in
```kconfig
menu "Configuration"
	depends on PACKAGE_nemea-framework

config NEMEA_LIBTRAP_BUFFER_SIZE
   int "Message buffer size"
   help
      Set size (in bytes) of libtrap buffer for messages, default is 5000.
   default 5000

config NEMEA_LIBTRAP_IFC_MAX_CLIENTS
   int "Output interface max clients"
   help
      Set number of clients that can connect to output interface, default is 8.
   default 8
endmenu
```

## net/beeeon-gateway/Config.in
```kconfig
menu "Configuration"
	depends on PACKAGE_beeeon-gateway

choice
	prompt "Gateway Identity"

config BEEEON_GATEWAY_ID_RANDOM
	bool "random"
	help
	  BeeeOn Gateway ID would be generated during the build
	  at random.

config BEEEON_GATEWAY_ID_CUSTOM
	bool "custom"
	help
	  BeeeOn Gateway ID is to be entered manually.

config BEEEON_GATEWAY_ID_CERT
	bool "from certificate"
	help
	  BeeeOn Gateway ID would be extracted from the given
	  certificate. It is thus required to give a path to
	  the gateway's private key, certificate and signing
	  certification authority.

endchoice

config BEEEON_GATEWAY_ID_CUSTOM_VALUE
	string "ID"
	depends on BEEEON_GATEWAY_ID_CUSTOM
	default "1254321374233360"
	help
	  The Gateway ID must be in the following decadic
	  format: VDDD DDDD DDDD DDDC. The V is "version"
	  and should be always 1. The series of D denotes
	  the unique identification part. The C is the DAMM
	  check sum digit.

config BEEEON_GATEWAY_ID_CERT_FILE
	string "Certificate file"
	depends on BEEEON_GATEWAY_ID_CERT
	help
	  The certification should prove that the gateway's
	  public key and ID are trusted by its signing CA.

config BEEEON_GATEWAY_ID_CERT_PKEY
	string "Private key file"
	depends on BEEEON_GATEWAY_ID_CERT
	help
	  Private key of the BeeeOn Gateway.

config BEEEON_GATEWAY_ID_CERT_AUTHORITY
	string "CA public key"
	depends on BEEEON_GATEWAY_ID_CERT
	help
	  The given file should represent the public key of CA
	  that has signed the certificate of the gateway.

config BEEEON_GATEWAY_GWS
	bool "GWS connector"
	default n
	help
	  Enable GWS connector, component to connect
	  to the remote BeeeOn Server.

config BEEEON_GATEWAY_GWS_HOST
	string "GWS host"
	depends on BEEEON_GATEWAY_GWS
	default "" if !BEEEON_GATEWAY_GWS

config BEEEON_GATEWAY_GWS_PORT
	int "GWS port"
	depends on BEEEON_GATEWAY_GWS
	range 1 65535
	default 8850

endmenu

menu "Modules"
	depends on PACKAGE_beeeon-gateway

config BEEEON_GATEWAY_USB_UART_RECOMMENDED
	bool
	default y if BEEEON_GATEWAY_ZWAVE
	default y if BEEEON_GATEWAY_IQRF
	default y if BEEEON_GATEWAY_JABLOTRON
	default n

config BEEEON_GATEWAY_HAS_KMOD_USB_ACM
	bool
	default y if PACKAGE_kmod-usb-acm
	default n

comment "You may need to select kmod-usb-acm to support UART-over-USB."
	depends on BEEEON_GATEWAY_USB_UART_RECOMMENDED
	depends on !BEEEON_GATEWAY_HAS_KMOD_USB_ACM

endmenu
```

## net/ipfixprobe/Config.in
```kconfig
menu "Flow cache configuration"
   config IPFIXPROBE_FLOW_CACHE_SIZE
      int "Flow cache size"
      help
         Set default size of flow cache as an exponent to the power of 2 number. Default is 14.
      default 14
   config IPFIXPROBE_FLOW_CACHELINE_SIZE
      int "Flow cache line size"
      help
         Set default size of flow line, accept exponent to the power of 2 number. Default is 2.
      default 2
endmenu
menu "Plugins"
   config IPFIXPROBE_PCAP
      bool "Enable PCAP (requires libpcap)"
      depends on PACKAGE_ipfixprobe
      help
         Enable pcap input plugin to load PCAP files and capture on NIC. There is "raw" input plugin available by default.
      default n
   config IPFIXPROBE_QUIC
      bool "Enable QUIC processing plugin (requires libopenssl)"
      depends on PACKAGE_ipfixprobe
      help
         Enable QUIC plugin to decrypt the protocol header and export information.
      default y
   config IPFIXPROBE_NEMEA
      bool "Enable UniRec output plugin (requires NEMEA)"
      depends on PACKAGE_ipfixprobe
      help
         Enable UniRec plugin to export IP flows via NEMEA (TRAP) interface in UniRec format.
      default n
endmenu
```

## net/nemea-modules/Config.in
```kconfig
menu "Configuration"
	depends on PACKAGE_nemea-flow_meter

   config NEMEA_FLOW_CACHE_SIZE
      int "Flow cache size"
      help
         Set size of flow cache in number of flow records. Default is 8192.
      default 8192
endmenu
```

## utils/nemea-modules/Config.in
```kconfig
menu "Configuration"
	depends on PACKAGE_nemea-modules

   menu "flow_meter module"
      config FLOW_CACHE_SIZE
         int "Flow cache size (must be divisible by 32)"
         help
            Set size of flow cache in number of flow records. Size must be divisible by 32. Default is 8192.
         default 8192
   endmenu
endmenu
```
